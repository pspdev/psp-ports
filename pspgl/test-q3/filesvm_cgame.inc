
SRC_FILES += \
	$(CODEDIR)/cgame/cg_consolecmds.c \
	$(CODEDIR)/cgame/cg_draw.c \
	$(CODEDIR)/cgame/cg_drawtools.c \
	$(CODEDIR)/cgame/cg_effects.c \
	$(CODEDIR)/cgame/cg_ents.c \
	$(CODEDIR)/cgame/cg_event.c \
	$(CODEDIR)/cgame/cg_info.c \
	$(CODEDIR)/cgame/cg_localents.c \
	$(CODEDIR)/cgame/cg_main.c \
	$(CODEDIR)/cgame/cg_marks.c \
	$(CODEDIR)/cgame/cg_particles.c \
	$(CODEDIR)/cgame/cg_players.c \
	$(CODEDIR)/cgame/cg_playerstate.c \
	$(CODEDIR)/cgame/cg_predict.c \
	$(CODEDIR)/cgame/cg_scoreboard.c \
	$(CODEDIR)/cgame/cg_servercmds.c \
	$(CODEDIR)/cgame/cg_snapshot.c \
	$(CODEDIR)/cgame/cg_syscalls.c \
	$(CODEDIR)/cgame/cg_view.c \
	$(CODEDIR)/cgame/cg_weapons.c

# not for classic Q3A, only for MISSIONPACK
#	$(CODEDIR)/cgame/cg_newdraw.c \


