
SRC_FILES += \
	$(CODEDIR)/q3_ui/ui_addbots.c \
	$(CODEDIR)/q3_ui/ui_atoms.c \
	$(CODEDIR)/q3_ui/ui_cdkey.c \
	$(CODEDIR)/q3_ui/ui_cinematics.c \
	$(CODEDIR)/q3_ui/ui_confirm.c \
	$(CODEDIR)/q3_ui/ui_connect.c \
	$(CODEDIR)/q3_ui/ui_controls2.c \
	$(CODEDIR)/q3_ui/ui_credits.c \
	$(CODEDIR)/q3_ui/ui_demo2.c \
	$(CODEDIR)/q3_ui/ui_display.c \
	$(CODEDIR)/q3_ui/ui_gameinfo.c \
	$(CODEDIR)/q3_ui/ui_ingame.c \
	$(CODEDIR)/q3_ui/ui_loadconfig.c \
	$(CODEDIR)/q3_ui/ui_login.c \
	$(CODEDIR)/q3_ui/ui_main.c \
	$(CODEDIR)/q3_ui/ui_menu.c \
	$(CODEDIR)/q3_ui/ui_mfield.c \
	$(CODEDIR)/q3_ui/ui_mods.c \
	$(CODEDIR)/q3_ui/ui_network.c \
	$(CODEDIR)/q3_ui/ui_options.c \
	$(CODEDIR)/q3_ui/ui_playermodel.c \
	$(CODEDIR)/q3_ui/ui_players.c \
	$(CODEDIR)/q3_ui/ui_playersettings.c \
	$(CODEDIR)/q3_ui/ui_preferences.c \
	$(CODEDIR)/q3_ui/ui_qmenu.c \
	$(CODEDIR)/q3_ui/ui_removebots.c \
	$(CODEDIR)/q3_ui/ui_saveconfig.c \
	$(CODEDIR)/q3_ui/ui_serverinfo.c \
	$(CODEDIR)/q3_ui/ui_servers2.c \
	$(CODEDIR)/q3_ui/ui_setup.c \
	$(CODEDIR)/q3_ui/ui_sound.c \
	$(CODEDIR)/q3_ui/ui_sparena.c \
	$(CODEDIR)/q3_ui/ui_specifyleague.c \
	$(CODEDIR)/q3_ui/ui_specifyserver.c \
	$(CODEDIR)/q3_ui/ui_splevel.c \
	$(CODEDIR)/q3_ui/ui_sppostgame.c \
	$(CODEDIR)/q3_ui/ui_spreset.c \
	$(CODEDIR)/q3_ui/ui_spskill.c \
	$(CODEDIR)/q3_ui/ui_startserver.c \
	$(CODEDIR)/q3_ui/ui_team.c \
	$(CODEDIR)/q3_ui/ui_teamorders.c \
	$(CODEDIR)/q3_ui/ui_video.c

# XXX FIXME ?!?
#	$(CODEDIR)/q3_ui/ui_rankings.c \
#	$(CODEDIR)/q3_ui/ui_rankstatus.c \
#	$(CODEDIR)/q3_ui/ui_signup.c \

